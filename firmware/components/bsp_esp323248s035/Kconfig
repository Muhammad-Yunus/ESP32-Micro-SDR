## firmware/components/bsp_esp323248s035/Kconfig
```kconfig
menu "BSP ESP32-3248S035"

    config BSP_TFT_SPI_CLK_HZ
        int "ST7796 SPI clock frequency (Hz)"
        range 1000000 80000000
        default 80000000
        help
            SPI clock used for the display. The original Arduino BSP runs the
            panel at 80 MHz.

    choice BSP_TFT_ROTATION
        prompt "Default display rotation"
        default BSP_TFT_ROTATION_270
        help
            Rotation applied at initialization. 270 degrees corresponds to the
            native "wide" (landscape) orientation of the Arduino BSP
            (MADCTL = 0xE0).

        config BSP_TFT_ROTATION_0
            bool "0 degrees (portrait)"
        config BSP_TFT_ROTATION_90
            bool "90 degrees (landscape)"
        config BSP_TFT_ROTATION_180
            bool "180 degrees (portrait inverted)"
        config BSP_TFT_ROTATION_270
            bool "270 degrees (landscape inverted, default)"
    endchoice

    config BSP_TFT_BACKLIGHT_DEFAULT
        int "Default backlight brightness (percent)"
        range 0 100
        default 100

    config BSP_LVGL
        bool "Enable the LVGL port"
        default y
        help
            Create a display, an input device, a tick timer and a handler task
            for LVGL 9. Requires the lvgl/lvgl component (see
            idf_component.yml).

    if BSP_LVGL

        config BSP_LVGL_BUFFER_LINES
            int "LVGL draw buffer height (lines)"
            range 1 80
            default 10
            help
                Number of display lines per draw buffer. Two buffers of
                (rotated width x this value) are allocated in DMA capable RAM.

        config BSP_LVGL_TICK_MS
            int "LVGL tick period (ms)"
            range 1 100
            default 10

        config BSP_LVGL_TASK_PERIOD_MS
            int "LVGL handler task period (ms)"
            range 1 100
            default 20

        config BSP_LVGL_TASK_PRIORITY
            int "LVGL handler task priority"
            default 4

        config BSP_LVGL_TASK_STACK
            int "LVGL handler task stack size (bytes)"
            default 6144

        config BSP_LVGL_TASK_CORE
            int "LVGL handler task core"
            range 0 1
            default 0
            help
                CPU the LVGL handler task is pinned to. Keep it on the opposite
                core from the ADC sampling task to spread the load.
    endif

    config BSP_LDR_POLL_HZ
        int "LDR ADC polling frequency (Hz)"
        range 50 5000
        default 1000
        help
            How often the LDR task reads ADC1 channel 6 (one-shot mode).
            One-shot reads are used instead of the continuous/DMA driver
            because the DAC continuous audio engine owns I2S0 on the ESP32.
            Higher rates give better oversampling; samples are averaged and
            published every 5 ms.

    config BSP_LDR_TASK_CORE
        int "LDR sampling task core"
        range 0 1
        default 1
        help
            CPU the LDR polling task is pinned to.

    choice BSP_AMP_DRIVER
        prompt "GPIO26 amplifier driver"
        default BSP_AMP_DRIVER_DAC
        help
            GPIO26 is DAC channel 1 and drives the on-board FM8002A class-AB
            audio amplifier (always powered, no enable pin). It can be driven
            either as a square-wave "buzzer" with LEDC, or with the DAC in
            continuous DMA mode for real analogue audio.

        config BSP_AMP_DRIVER_BUZZER
            bool "LEDC square-wave buzzer"
        config BSP_AMP_DRIVER_DAC
            bool "DAC continuous (DMA) sine / audio"
    endchoice

    if BSP_AMP_DRIVER_DAC
        config BSP_AUDIO_SAMPLE_RATE_HZ
            int "DAC audio sample rate (Hz)"
            range 40000 2000000
            default 200000
            help
                DAC continuous (DMA) sample rate. Must exceed twice the highest
                tone (the UI slider goes up to 1500 Hz), hence at least 3 kHz.

        config BSP_AUDIO_TASK_CORE
            int "Audio generation task core"
            range 0 1
            default 1

        config BSP_AUDIO_BUF_SAMPLES
            int "Samples generated per DMA write"
            range 256 16384
            default 4096

        config BSP_AUDIO_AMPLITUDE
            int "Sine amplitude (0..127)"
            range 1 127
            default 100

        config BSP_AUDIO_DEFAULT_FREQ_HZ
            int "Default tone frequency (Hz)"
            range 20 1500
            default 320
    endif

endmenu
```

## firmware/main/Kconfig.projbuild
```kconfig
menu "SDR Configuration"

config SDR_ADC_FS_HZ
    int "ADC sample rate per channel (Hz)"
    default 48000
    help
        Target sampling rate for each I/Q channel. Actual rate is measured
        at runtime and used for NCO/FFT calculations.

config SDR_FFT_N
    int "FFT size (points)"
    default 1024
    help
        Spectrum FFT length at the decimated 12 kHz IQ stream.

config SDR_DISPLAY_SPAN_HZ
    int "Default display span (+/- Hz)"
    default 500
    help
        Initial half-width of the spectrum/waterfall display around the
        tuned frequency. At runtime the span is changed from the Settings
        modal (250/500/1k/2k/5k/10k Hz) and clamped to FS/2.

config SDR_BFO_HZ
    int "BFO frequency (Hz)"
    default 1500
    help
        Second mixer of the Weaver demodulator (passband center).

config SDR_WATERFALL_ROWS
    int "Waterfall rows"
    default 64
    help
        Number of waterfall lines (each line = one spectrum snapshot).
        Reduce to 48 if internal RAM is tight.

config SDR_ADC_ATTEN_DB
    int "ADC attenuation (dB)"
    default 11
    help
        ADC input attenuation, dipetakan ke enum `adc_atten_t`:
        0 -> 0 dB, 3 -> 2.5 dB, 6 -> 6 dB, 11 -> ~12 dB (rentang penuh).
        Nilai lain menggagalkan kompilasi (rx_adc.c). 11 dB cocok dengan
        keluaran front-end <= +/-1 V di sekitar bias 1,65 V.

config SDR_ADC_POOL_BYTES
    int "ADC DMA internal pool (bytes)"
    default 8192
    help
        Driver ring for raw conversion results; a full pool triggers the
        overrun callback counted by rx_adc_overrun_count().

config SDR_ADC_CONV_FRAME_BYTES
    int "ADC conversion frame (bytes)"
    default 256
    help
        Bytes per DMA conversion frame; must be a multiple of
        SOC_ADC_DIGI_DATA_BYTES_PER_CONV (4 on ESP32).

config SDR_ADC_BLOCK_FRAMES
    int "DSP block size (I/Q frames)"
    default 256
    help
        Frames per processed block (= 5.33 ms at 48 kHz), matching one
        audio block of 256 samples.

config SDR_DEFAULT_LO_HZ
    int "Default LO label (Hz)"
    default 20000000
    help
        Visual-only LO frequency label shown in the top bar (the real LO
        is driven by an external Si5351 controller).

config SDR_LO_MAX_HZ
    int "Maximum LO label (Hz)"
    default 30000000
    help
        Upper bound for the visual-only LO frequency label (7-segment bar)
        and for the keypad "LO label" entry.

config SDR_NCO_LIMIT_HZ
    int "NCO offset limit (+/- Hz)"
    default 2000000
    help
        Maximum software offset tuning range, applied around the LO label
        (default 2 MHz). The UI clamps keypad entry to +/- this value.

config SDR_DEFAULT_VOLUME_PCT
    int "Default volume (%)"
    range 0 100
    default 50
    help
        Initial audio volume percentage.

config SDR_AUDIO_FS_HZ
    int "Audio output sample rate (Hz)"
    default 12000
    help
        Rate of the demodulated audio stream feeding the sigma-delta
        modulator; also the pacing rate of audio_feed_task (one density
        update per sample period).

config SDR_AUDIO_BLOCK_SAMPLES
    int "Audio block size (samples)"
    default 256
    help
        Samples per queued audio block (~21.3 ms at 12 kHz), see
        docs/ARCHITECTURE.md section 4.

config SDR_SDM_GPIO
    int "Sigma-delta output GPIO"
    default 26
    help
        GPIO routed via the GPIO matrix to the sigma-delta modulator;
        the board wires GPIO26 to the FM8002A amplifier.

config SDR_SDM_CARRIER_HZ
    int "Sigma-delta carrier rate (Hz)"
    default 10000000
    help
        Pulse rate of the 1-bit modulator (must exceed every test/audio
        frequency by a wide margin). The driver derives an integer
        prescaler from the 80 MHz APB clock and warns on precision loss;
        10 MHz divides exactly (prescaler 8) and matches the Espressif
        sdm_dac audio example.

config SDR_AUDIO_TONE_HZ
    int "Internal test tone frequency (Hz, 0 = off)"
    range 0 1000000
    default 0
    help
        When non-zero, audio_feed_task synthesizes a continuous-phase
        sine of this frequency directly at the SDM write rate (online
        calibrated — bring-up/diag of the SDM/amp path, F4). Amplitude
        follows the volume control (sdr_config volume_pct). 0 =
        production: the queue path plays demodulated audio from dsp_chain
        (F5). Keep 0 in production.

config SDR_DC_POLE_R
    float "DC-block pole radius"
    default 0.996
    help
        Single-pole DC removal y[n] = x[n] - x[n-1] + R*y[n-1] per I/Q
        channel before the NCO (docs/ARCHITECTURE.md section 6, stage 2).
        Cutoff ~ (1-R)*fs/(2*pi) ~ 30 Hz at 48 kHz for R = 0.996.

config SDR_CH_LPF_HZ
    float "Channel LPF cutoff (Hz)"
    default 2700.0
    help
        Cutoff of the channel low-pass before each decimation-by-2 stage
        (48 -> 24 -> 12 kHz, stages 4a/4b). 2700 Hz keeps the full SSB
        passband and rejects the alias band of each decimation stage.

config SDR_AUDIO_LPF_HZ
    float "Audio LPF cutoff (Hz)"
    default 2000.0
    help
        FIR low-pass on the BFO I component at 12 kHz (stage 6): final
        audio bandwidth before AGC.

config SDR_AGC_TARGET
    int "AGC target level (0 = AGC off)"
    range 0 127
    default 96
    help
        Desired steady-state audio peak (int8 scale) of the automatic
        gain control (stage 7). 0 disables AGC (unity gain); the runtime
        override lives in sdr_config agc_target.

config SDR_AGC_ATTACK_MS
    float "AGC attack time (ms)"
    default 5.0
    help
        Envelope attack time constant; alpha = 1 - exp(-1/(tau*fs)).

config SDR_AGC_RELEASE_MS
    float "AGC release time (ms)"
    default 200.0
    help
        Envelope release time constant; alpha = 1 - exp(-1/(tau*fs)).

endmenu
```
